## Team_Aquila/build/Kconfig/boards/Kconfig.defconfig
```kconfig
# Load Zephyr board defconfig descriptions.
osource "/home/halo/aquila/zephyr/boards/st/nucleo_f446re/Kconfig.defconfig"
```

## Team_Aquila/build/Kconfig/boards/Kconfig.sysbuild
```kconfig
# Load Sysbuild board Kconfig descriptions.
osource "/home/halo/aquila/zephyr/boards/st/nucleo_f446re/Kconfig.sysbuild"
```

## build/Kconfig/arch/Kconfig
```kconfig
# Load Zephyr Arch Kconfig descriptions.
osource "/home/halo/aquila/zephyr/arch/tricore/Kconfig"
osource "/home/halo/aquila/zephyr/arch/hexagon/Kconfig"
osource "/home/halo/aquila/zephyr/arch/rx/Kconfig"
osource "/home/halo/aquila/zephyr/arch/x86/Kconfig"
osource "/home/halo/aquila/zephyr/arch/xtensa/Kconfig"
osource "/home/halo/aquila/zephyr/arch/sparc/Kconfig"
osource "/home/halo/aquila/zephyr/arch/riscv/Kconfig"
osource "/home/halo/aquila/zephyr/arch/posix/Kconfig"
osource "/home/halo/aquila/zephyr/arch/openrisc/Kconfig"
osource "/home/halo/aquila/zephyr/arch/mips/Kconfig"
osource "/home/halo/aquila/zephyr/arch/arm64/Kconfig"
osource "/home/halo/aquila/zephyr/arch/arm/Kconfig"
osource "/home/halo/aquila/zephyr/arch/arc/Kconfig"
```

## build/Kconfig/boards/Kconfig
```kconfig
# Load Zephyr board Kconfig descriptions.
osource "/home/halo/aquila/zephyr/boards/st/nucleo_f446re/Kconfig"
```

## build/Kconfig/boards/Kconfig.nucleo_f446re
```kconfig
# Load board Kconfig descriptions.
osource "/home/halo/aquila/zephyr/boards/st/nucleo_f446re/Kconfig.nucleo_f446re"
```
