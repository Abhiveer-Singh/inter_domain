## prj.conf
```kconfig
CONFIG_GPIO=y
CONFIG_PWM=y

CONFIG_SERIAL=y
CONFIG_CONSOLE=y
CONFIG_UART_CONSOLE=y
CONFIG_PRINTK=y
CONFIG_I2C=y
CONFIG_SENSOR=y
CONFIG_MPU6050=y
CONFIG_BME280=y
CONFIG_DHT=y
CONFIG_ADC=y
CONFIG_VL53L0X=y
CONFIG_ADC=y
```

## src/main.c
```c
#include "ahrs_ekf.h"
#include "bioSensors.h"
#include "gps.h"
#include "imu.h"
#include "motion.h"
#include "tof.h"
#include <math.h>
#include <string.h>
#include <zephyr/devicetree.h>
#include <zephyr/kernel.h>

#define STACK_SIZE 2048
#define IMU_STACK_SIZE 3072
#define TOF_STACK_SIZE 3072
#define PRIO 5
#define IMU_PRIO 4
#define DEG2RAD 0.01745329252f

/* GPS UART (usart6, PC6/PC7) comes from the overlay's zephyr,user node */
#define GPS_UART DEVICE_DT_GET(DT_PHANDLE(DT_PATH(zephyr_user), gps_uart))

/* 1 = run a short drive pattern for bench testing. WHEELS OFF THE GROUND! */
#define MOTION_DEMO 1

/* demo drive speed, 0.0 to 1.0 (0.5 = 50% duty) */
#define DEMO_SPEED 0.5f

struct attitude {
  float roll_deg;
  float pitch_deg;
  float heading_deg;
  bool aligned; /* heading locked to GPS course */
};

struct readings {
  struct dht11_data dht;
  struct bmp280_data bmp;
  struct uv_data uv;
  struct gps_data gps;
  struct attitude att;
  struct tof_data tof;
  float gps_hdop;
  int64_t gps_age_ms;
};

static struct readings data = {
    .dht = {NAN, NAN},
    .bmp = {NAN, NAN},
    .uv = {NAN, NAN},
    .gps = {false, 0, NAN, NAN, NAN, NAN, NAN, 0},
    .att = {NAN, NAN, NAN, false},
    .tof = {NAN},
    .gps_hdop = NAN,
    .gps_age_ms = -1,
};

K_MUTEX_DEFINE(data_lock);

static ekf_t ekf;
K_MUTEX_DEFINE(ekf_lock);

static void dht_thread(void *a, void *b, void *c) {
  struct dht11_data d;

  if (dht11_sensor_init()) {
    printk("DHT11 not ready\n");
    return;
  }
  while (1) {
    int rc = dht11_sensor_read(&d);

    if (rc == 0) {
      k_mutex_lock(&data_lock, K_FOREVER);
      data.dht = d;
      k_mutex_unlock(&data_lock);
    } else {
      printk("DHT11 read error: %d\n", rc);
    }
    k_sleep(K_SECONDS(2));
  }
}

static void bmp_thread(void *a, void *b, void *c) {
  struct bmp280_data d;

  if (bmp280_sensor_init()) {
    printk("BMP280 not ready\n");
    return;
  }
  while (1) {
    if (bmp280_sensor_read(&d) == 0) {
      k_mutex_lock(&data_lock, K_FOREVER);
      data.bmp = d;
      k_mutex_unlock(&data_lock);
    }
    k_sleep(K_MSEC(500));
  }
}

static void uv_thread(void *a, void *b, void *c) {
  struct uv_data d;

  if (uv_sensor_init()) {
    printk("UV sensor ADC setup failed\n");
    return;
  }
  while (1) {
    if (uv_sensor_read(&d) == 0) {
      k_mutex_lock(&data_lock, K_FOREVER);
      data.uv = d;
      k_mutex_unlock(&data_lock);
    }
    k_sleep(K_MSEC(200));
  }
}

static void tof_thread(void *a, void *b, void *c) {
  struct tof_data d;

  if (tof_sensor_init()) {
    printk("VL53 not ready\n");
    return;
  }
  while (1) {
    if (tof_sensor_read(&d) == 0) {
      k_mutex_lock(&data_lock, K_FOREVER);
      data.tof = d;
      k_mutex_unlock(&data_lock);
    }
    k_sleep(K_MSEC(100));
  }
}

static void gps_thread(void *a, void *b, void *c) {
  struct gps_fix f;
  struct gps_data g;
  uint32_t last_rmc = 0;

  if (gps_init(GPS_UART)) {
    printk("GPS not ready\n");
    return;
  }
  while (1) {
    /* true only for a fresh fix that passes sats/HDOP/status checks */
    bool ok = gps_get_fix(&f);

    memset(&g, 0, sizeof(g));
    g.valid = ok;
    g.satellites = f.sats;
    g.rmc_count = f.seq;
    if (ok) {
      g.lat_deg = f.lat;
      g.lon_deg = f.lon;
      g.altitude_m = f.alt_m;
      g.speed_ms = f.speed_kmh / 3.6f;
      g.course_deg = f.course_deg;
    } else {
      g.lat_deg = NAN;
      g.lon_deg = NAN;
      g.altitude_m = NAN;
      g.speed_ms = NAN;
      g.course_deg = NAN;
    }

    k_mutex_lock(&data_lock, K_FOREVER);
    data.gps = g;
    data.gps_hdop = f.hdop;
    data.gps_age_ms = f.age_ms;
    k_mutex_unlock(&data_lock);

    /* feed each new GPS report to the EKF exactly once */
    if (g.valid && g.rmc_count != last_rmc) {
      last_rmc = g.rmc_count;
      k_mutex_lock(&ekf_lock, K_FOREVER);
      ekf_update_course(&ekf, g.course_deg * DEG2RAD, g.speed_ms);
      k_mutex_unlock(&ekf_lock);
    }
    k_sleep(K_MSEC(100));
  }
}

static void imu_thread(void *a, void *b, void *c) {
  struct imu_data imu;
  float bias[3], acc[3];

  if (mpu6050_sensor_init()) {
    printk("MPU6050 not ready\n");
    return;
  }

  /* ---- startup calibration: rover must be still for ~2 s ---- */
  while (1) {
    float gsum[3] = {0}, asum[3] = {0};
    int n = 0;

    for (int i = 0; i < 200; i++) {
      if (mpu6050_sensor_read(&imu) == 0) {
        for (int k = 0; k < 3; k++) {
          gsum[k] += imu.gyro_rads[k];
          asum[k] += imu.accel_g[k];
        }
        n++;
      }
      k_sleep(K_MSEC(10));
    }
    if (n < 100) {
      printk("IMU: read errors during calibration, retrying\n");
      continue;
    }
    for (int k = 0; k < 3; k++) {
      bias[k] = gsum[k] / n;
      acc[k] = asum[k] / n;
    }
    if (fabsf(bias[0]) < 0.1f && fabsf(bias[1]) < 0.1f &&
        fabsf(bias[2]) < 0.1f) {
      break;
    }
    printk("IMU: rover is moving, keep it still. Retrying\n");
  }

  k_mutex_lock(&ekf_lock, K_FOREVER);
  ekf_init(&ekf, acc, bias);
  k_mutex_unlock(&ekf_lock);
  printk("IMU: calibrated, gyro bias %.4f %.4f %.4f rad/s\n", (double)bias[0],
         (double)bias[1], (double)bias[2]);

  int64_t ref = k_uptime_get();

  while (1) {
    k_sleep(K_MSEC(10)); /* 100 Hz, matches the MPU6050 setting */

    float dt = (float)k_uptime_delta(&ref) / 1000.0f;

    if (mpu6050_sensor_read(&imu) != 0) {
      continue;
    }

    struct attitude att;

    k_mutex_lock(&ekf_lock, K_FOREVER);
    ekf_predict(&ekf, imu.gyro_rads, dt);
    ekf_update_accel(&ekf, imu.accel_g);
    att.roll_deg = ekf_roll_deg(&ekf);
    att.pitch_deg = ekf_pitch_deg(&ekf);
    att.heading_deg = ekf_heading_deg(&ekf);
    att.aligned = ekf.yaw_aligned;
    k_mutex_unlock(&ekf_lock);

    k_mutex_lock(&data_lock, K_FOREVER);
    data.att = att;
    k_mutex_unlock(&data_lock);

    /* heading only goes to the motion code once GPS has aligned it */
    if (att.aligned) {
      motion_update_heading_measurement(att.heading_deg);
    }
  }
}

K_THREAD_DEFINE(dht_tid, STACK_SIZE, dht_thread, NULL, NULL, NULL, PRIO, 0, 0);
K_THREAD_DEFINE(bmp_tid, STACK_SIZE, bmp_thread, NULL, NULL, NULL, PRIO, 0, 0);
K_THREAD_DEFINE(uv_tid, STACK_SIZE, uv_thread, NULL, NULL, NULL, PRIO, 0, 0);
K_THREAD_DEFINE(tof_tid, TOF_STACK_SIZE, tof_thread, NULL, NULL, NULL, PRIO, 0,
                0);
K_THREAD_DEFINE(gps_tid, STACK_SIZE, gps_thread, NULL, NULL, NULL, PRIO, 0, 0);
K_THREAD_DEFINE(imu_tid, IMU_STACK_SIZE, imu_thread, NULL, NULL, NULL, IMU_PRIO,
                0, 0);

int main(void) {
  int tick = 0;

  if (motion_init()) {
    printk("Motion init failed\n");
  } else {
    motion_enable(true);
  }

  while (1) {
#if MOTION_DEMO
    /* 8 s loop: forward, stop, reverse, stop */
    int phase = (int)((k_uptime_get() / 1000) % 8);

    if (phase < 3) {
      motion_set_drive(DEMO_SPEED, 0.0f); /* forward */
    } else if (phase < 4) {
      motion_set_drive(0.0f, 0.0f); /* stop briefly before reversing */
    } else if (phase < 7) {
      motion_set_drive(-DEMO_SPEED, 0.0f); /* reverse */
    } else {
      motion_set_drive(0.0f, 0.0f); /* stop */
    }
#endif

    if (++tick >= 4) { /* print every 2 s */
      struct readings d;

      tick = 0;
      k_mutex_lock(&data_lock, K_FOREVER);
      d = data;
      k_mutex_unlock(&data_lock);

      printk("----------------------------------------\n");
      printk("DHT11  : %.1f C   %.1f %%RH\n", d.dht.temp_c, d.dht.humidity);
      printk("BMP280 : %.2f C   %.2f hPa\n", d.bmp.temp_c, d.bmp.pressure_hpa);
      printk("UV     : %.3f V   UV index ~%.1f\n", d.uv.volts, d.uv.index);
      printk("ToF    : %.0f mm\n", (double)d.tof.dist_mm);
      printk("GPS    : fix=%d sats=%d lat=%.6f lon=%.6f\n", (int)d.gps.valid,
             d.gps.satellites, d.gps.lat_deg, d.gps.lon_deg);
      printk("         speed=%.2f m/s  course=%.1f deg  alt=%.1f m\n",
             (double)d.gps.speed_ms, (double)d.gps.course_deg,
             (double)d.gps.altitude_m);
      printk("         hdop=%.1f  fix age=%d ms\n", (double)d.gps_hdop,
             (int)d.gps_age_ms);
      printk("IMU    : roll=%.1f pitch=%.1f heading=%.1f deg (%s)\n",
             (double)d.att.roll_deg, (double)d.att.pitch_deg,
             (double)d.att.heading_deg,
             d.att.aligned ? "GPS-aligned" : "NOT aligned");
    }

    k_sleep(K_MSEC(500));
  }
  return 0;
}
```

## src/ahrs_ekf.c
```c
#include "ahrs_ekf.h"
#include <math.h>
#include <string.h>

#define N 6
#define PI_F 3.14159265f

/* ---- tuning ---- */
#define Q_ANGLE 1.0e-4f    /* gyro noise, (rad/s)^2 */
#define Q_BIAS 1.0e-7f     /* gyro bias random walk */
#define R_ACC 2.5e-3f      /* (0.05 g)^2, accel unit-vector noise */
#define ACC_GATE_G 0.15f   /* ignore accel when |a| is off 1 g by more */
#define GPS_MIN_SPEED 0.6f /* m/s, below this course is unreliable */
#define GPS_MAX_RATE 0.35f /* rad/s, skip course while turning (slip) */
#define PITCH_LIMIT 1.45f  /* rad, keeps tan/1/cos finite */

static float wrap_pi(float a) {
  while (a > PI_F) {
    a -= 2.0f * PI_F;
  }
  while (a <= -PI_F) {
    a += 2.0f * PI_F;
  }
  return a;
}

static float clampf(float v, float lo, float hi) {
  return v < lo ? lo : (v > hi ? hi : v);
}

/* C = A * B */
static void mat_mul(float C[N][N], const float A[N][N], const float B[N][N]) {
  for (int i = 0; i < N; i++) {
    for (int j = 0; j < N; j++) {
      float s = 0.0f;

      for (int k = 0; k < N; k++) {
        s += A[i][k] * B[k][j];
      }
      C[i][j] = s;
    }
  }
}

/* C = A * B^T */
static void mat_mul_bt(float C[N][N], const float A[N][N],
                       const float B[N][N]) {
  for (int i = 0; i < N; i++) {
    for (int j = 0; j < N; j++) {
      float s = 0.0f;

      for (int k = 0; k < N; k++) {
        s += A[i][k] * B[j][k];
      }
      C[i][j] = s;
    }
  }
}

void ekf_init(ekf_t *e, const float a[3], const float bias[3]) {
  memset(e, 0, sizeof(*e));

  float n = sqrtf(a[0] * a[0] + a[1] * a[1] + a[2] * a[2]);

  if (n < 1.0e-3f) {
    n = 1.0f;
  }
  float ax = a[0] / n, ay = a[1] / n, az = a[2] / n;

  /* at rest in FRD, accel reads [sin(th), -sin(ph)cos(th), -cos(ph)cos(th)] */
  e->x[0] = atan2f(-ay, -az);
  e->x[1] = asinf(clampf(ax, -1.0f, 1.0f));
  e->x[2] = 0.0f;
  e->x[3] = bias[0];
  e->x[4] = bias[1];
  e->x[5] = bias[2];

  e->P[0][0] = 0.05f * 0.05f;
  e->P[1][1] = 0.05f * 0.05f;
  e->P[2][2] = PI_F * PI_F; /* heading completely unknown */
  e->P[3][3] = 0.01f * 0.01f;
  e->P[4][4] = 0.01f * 0.01f;
  e->P[5][5] = 0.01f * 0.01f;

  e->initialised = true;
}

void ekf_predict(ekf_t *e, const float g[3], float dt) {
  if (!e->initialised || dt <= 0.0f || dt > 0.1f) {
    return;
  }

  float phi = e->x[0];
  float th = clampf(e->x[1], -PITCH_LIMIT, PITCH_LIMIT);
  float p = g[0] - e->x[3];
  float q = g[1] - e->x[4];
  float r = g[2] - e->x[5];

  float sp = sinf(phi), cp = cosf(phi);
  float st = sinf(th), ct = cosf(th), tt = tanf(th);
  float ct2 = ct * ct;
  float qs_rc = q * sp + r * cp;
  float qc_rs = q * cp - r * sp;

  /* Euler-angle kinematics */
  float f0 = p + qs_rc * tt;
  float f1 = qc_rs;
  float f2 = qs_rc / ct;

  /* Jacobian of the process model */
  float F[N][N] = {{0}};

  F[0][0] = qc_rs * tt;
  F[0][1] = qs_rc / ct2;
  F[0][3] = -1.0f;
  F[0][4] = -sp * tt;
  F[0][5] = -cp * tt;

  F[1][0] = -qs_rc;
  F[1][4] = -cp;
  F[1][5] = sp;

  F[2][0] = qc_rs / ct;
  F[2][1] = qs_rc * st / ct2;
  F[2][4] = -sp / ct;
  F[2][5] = -cp / ct;

  /* state prediction */
  e->x[0] = wrap_pi(e->x[0] + f0 * dt);
  e->x[1] = clampf(e->x[1] + f1 * dt, -PITCH_LIMIT, PITCH_LIMIT);
  e->x[2] = wrap_pi(e->x[2] + f2 * dt);
  e->rate_r = f2;

  /* covariance prediction: P = Fd P Fd^T + Q, with Fd = I + F dt */
  float Fd[N][N];

  for (int i = 0; i < N; i++) {
    for (int j = 0; j < N; j++) {
      Fd[i][j] = (i == j ? 1.0f : 0.0f) + F[i][j] * dt;
    }
  }

  float T[N][N], P2[N][N];

  mat_mul(T, Fd, e->P);
  mat_mul_bt(P2, T, Fd);
  memcpy(e->P, P2, sizeof(P2));

  for (int i = 0; i < 3; i++) {
    e->P[i][i] += Q_ANGLE * dt;
  }
  for (int i = 3; i < N; i++) {
    e->P[i][i] += Q_BIAS * dt;
  }
}

/* One scalar measurement update, Joseph form for numerical stability */
static void scalar_update(ekf_t *e, float innov, const float H[N], float R) {
  float PHt[N];

  for (int i = 0; i < N; i++) {
    float s = 0.0f;

    for (int j = 0; j < N; j++) {
      s += e->P[i][j] * H[j];
    }
    PHt[i] = s;
  }

  float S = R;

  for (int i = 0; i < N; i++) {
    S += H[i] * PHt[i];
  }
  if (S < 1.0e-9f) {
    return;
  }

  float K[N];

  for (int i = 0; i < N; i++) {
    K[i] = PHt[i] / S;
    e->x[i] += K[i] * innov;
  }

  float A[N][N], T[N][N], P2[N][N];

  for (int i = 0; i < N; i++) {
    for (int j = 0; j < N; j++) {
      A[i][j] = (i == j ? 1.0f : 0.0f) - K[i] * H[j];
    }
  }
  mat_mul(T, A, e->P);
  mat_mul_bt(P2, T, A);

  for (int i = 0; i < N; i++) {
    for (int j = 0; j < N; j++) {
      P2[i][j] += R * K[i] * K[j];
    }
  }
  for (int i = 0; i < N; i++) {
    for (int j = 0; j < N; j++) {
      e->P[i][j] = 0.5f * (P2[i][j] + P2[j][i]); /* keep symmetric */
    }
  }

  e->x[0] = wrap_pi(e->x[0]);
  e->x[1] = clampf(e->x[1], -PITCH_LIMIT, PITCH_LIMIT);
  e->x[2] = wrap_pi(e->x[2]);
}

void ekf_update_accel(ekf_t *e, const float a[3]) {
  if (!e->initialised) {
    return;
  }

  float n = sqrtf(a[0] * a[0] + a[1] * a[1] + a[2] * a[2]);
  float dev = fabsf(n - 1.0f);

  if (n < 1.0e-3f || dev > ACC_GATE_G) {
    return; /* accelerating or vibrating: gravity direction unreliable */
  }

  float z[3] = {a[0] / n, a[1] / n, a[2] / n};
  float R = R_ACC * (1.0f + 20.0f * dev);

  for (int k = 0; k < 3; k++) {
    float phi = e->x[0], th = e->x[1];
    float sp = sinf(phi), cp = cosf(phi);
    float st = sinf(th), ct = cosf(th);
    float h, H[N] = {0};

    if (k == 0) {
      h = st;
      H[1] = ct;
    } else if (k == 1) {
      h = -sp * ct;
      H[0] = -cp * ct;
      H[1] = sp * st;
    } else {
      h = -cp * ct;
      H[0] = sp * ct;
      H[1] = cp * st;
    }
    scalar_update(e, z[k] - h, H, R);
  }
}

void ekf_update_course(ekf_t *e, float course_rad, float speed_ms) {
  if (!e->initialised) {
    return;
  }
  if (speed_ms < GPS_MIN_SPEED || fabsf(e->rate_r) > GPS_MAX_RATE) {
    return;
  }

  /* noisier at low speed: 3 deg + 10 deg / (m/s) */
  float sigma = (3.0f + 10.0f / speed_ms) * (PI_F / 180.0f);
  float H[N] = {0, 0, 1, 0, 0, 0};
  float innov = wrap_pi(course_rad - e->x[2]);

  scalar_update(e, innov, H, sigma * sigma);
  e->yaw_aligned = true;
}

float ekf_heading_deg(const ekf_t *e) {
  float d = e->x[2] * (180.0f / PI_F);

  while (d < 0.0f) {
    d += 360.0f;
  }
  while (d >= 360.0f) {
    d -= 360.0f;
  }
  return d;
}

float ekf_roll_deg(const ekf_t *e) { return e->x[0] * (180.0f / PI_F); }

float ekf_pitch_deg(const ekf_t *e) { return e->x[1] * (180.0f / PI_F); }
```

## src/ahrs_ekf.h
```c
#pragma once
#include <stdbool.h>

/* Body frame: X forward, Y right, Z down.
 * State: roll, pitch, yaw (rad, yaw = heading clockwise from north),
 *        gyro bias p, q, r (rad/s). */
typedef struct {
  float x[6];
  float P[6][6];
  float rate_r; /* last heading rate, rad/s */
  bool initialised;
  bool yaw_aligned; /* true after the first GPS course update */
} ekf_t;

void ekf_init(ekf_t *e, const float accel_g[3], const float gyro_bias[3]);
void ekf_predict(ekf_t *e, const float gyro_rads[3], float dt);
void ekf_update_accel(ekf_t *e, const float accel_g[3]);
void ekf_update_course(ekf_t *e, float course_rad, float speed_ms);

float ekf_heading_deg(const ekf_t *e); /* 0..360 */
float ekf_roll_deg(const ekf_t *e);
float ekf_pitch_deg(const ekf_t *e);
```

## src/gps.h
```c
#ifndef GPS_H_
#define GPS_H_

#include <stdbool.h>
#include <stdint.h>
#include <zephyr/device.h>

/* Reject fixes worse than this (lower HDOP = better accuracy) */
#define GPS_MAX_HDOP 2.5f
/* Reject fixes with fewer satellites than this */
#define GPS_MIN_SATS 4
/* A fix older than this (ms) is reported as invalid */
#define GPS_MAX_AGE_MS 3000
/* Measurement rate in ms (NEO-6M supports down to 200 ms = 5 Hz) */
#define GPS_RATE_MS 200

struct gps_fix {
  bool valid;  /* true only when fix passes all quality checks */
  double lat;  /* decimal degrees, + = N */
  double lon;  /* decimal degrees, + = E */
  float alt_m; /* altitude above mean sea level, metres */
  float speed_kmh;
  float course_deg;
  float hdop;
  uint8_t sats;           /* satellites used */
  uint8_t quality;        /* GGA quality: 0 none, 1 GPS, 2 DGPS */
  uint8_t hour, min, sec; /* UTC */
  int64_t age_ms;         /* time since the last good GGA */
  uint32_t seq; /* increments on every new RMC report (course/speed) */
};

/* Start the GPS driver on the given UART (9600 baud NMEA). Returns 0 on
 * success. */
int gps_init(const struct device *uart);

/* Copy the latest fix. Returns true only if the fix is valid and fresh. */
bool gps_get_fix(struct gps_fix *out);

#endif /* GPS_H_ */
```

## src/imu.c
```c
#include "imu.h"
#include <errno.h>
#include <zephyr/drivers/i2c.h>
#include <zephyr/kernel.h>

#define MPU_REG_SMPLRT_DIV 0x19
#define MPU_REG_CONFIG 0x1A
#define MPU_REG_GYRO_CONFIG 0x1B
#define MPU_REG_ACCEL_CONFIG 0x1C
#define MPU_REG_ACCEL_XOUT_H 0x3B
#define MPU_REG_PWR_MGMT_1 0x6B
#define MPU_REG_WHO_AM_I 0x75

#define MPU_ACCEL_LSB_PER_G 16384.0f /* +-2 g     */
#define MPU_GYRO_LSB_PER_DPS 65.5f   /* +-500 dps */
#define MPU_DEG2RAD 0.01745329252f

static const struct i2c_dt_spec mpu = I2C_DT_SPEC_GET(DT_NODELABEL(mpu6050));

int mpu6050_sensor_init(void) {
  uint8_t id;
  int ret;

  if (!i2c_is_ready_dt(&mpu)) {
    return -ENODEV;
  }
  ret = i2c_reg_read_byte_dt(&mpu, MPU_REG_WHO_AM_I, &id);
  if (ret) {
    return ret;
  }
  /* genuine parts answer 0x68, some clones use other IDs */
  if (id != 0x68 && id != 0x70 && id != 0x71 && id != 0x72 && id != 0x73 &&
      id != 0x98) {
    return -ENODEV;
  }

  i2c_reg_write_byte_dt(&mpu, MPU_REG_PWR_MGMT_1, 0x80); /* reset */
  k_msleep(100);
  i2c_reg_write_byte_dt(&mpu, MPU_REG_PWR_MGMT_1, 0x01); /* wake, PLL clock */
  k_msleep(10);

  ret = i2c_reg_write_byte_dt(&mpu, MPU_REG_CONFIG, 0x03); /* low-pass ~42 Hz */
  ret |= i2c_reg_write_byte_dt(&mpu, MPU_REG_SMPLRT_DIV,
                               0x09); /* 1 kHz / 10 = 100 Hz */
  ret |= i2c_reg_write_byte_dt(&mpu, MPU_REG_GYRO_CONFIG, 0x08); /* +-500 dps */
  ret |= i2c_reg_write_byte_dt(&mpu, MPU_REG_ACCEL_CONFIG, 0x00); /* +-2 g */
  return ret ? -EIO : 0;
}

int mpu6050_sensor_read(struct imu_data *out) {
  uint8_t b[14];
  int ret = i2c_burst_read_dt(&mpu, MPU_REG_ACCEL_XOUT_H, b, sizeof(b));

  if (ret) {
    return ret;
  }

  int16_t ax = (int16_t)((b[0] << 8) | b[1]);
  int16_t ay = (int16_t)((b[2] << 8) | b[3]);
  int16_t az = (int16_t)((b[4] << 8) | b[5]);
  int16_t gx = (int16_t)((b[8] << 8) | b[9]);
  int16_t gy = (int16_t)((b[10] << 8) | b[11]);
  int16_t gz = (int16_t)((b[12] << 8) | b[13]);

  float sax = ax / MPU_ACCEL_LSB_PER_G;
  float say = ay / MPU_ACCEL_LSB_PER_G;
  float saz = az / MPU_ACCEL_LSB_PER_G;
  float sgx = gx / MPU_GYRO_LSB_PER_DPS * MPU_DEG2RAD;
  float sgy = gy / MPU_GYRO_LSB_PER_DPS * MPU_DEG2RAD;
  float sgz = gz / MPU_GYRO_LSB_PER_DPS * MPU_DEG2RAD;

  /* MOUNTING: sensor frame (X forward, Y left, Z up) -> body frame
   * (X forward, Y right, Z down). Change this if you mount it differently. */
  out->accel_g[0] = sax;
  out->accel_g[1] = -say;
  out->accel_g[2] = -saz;
  out->gyro_rads[0] = sgx;
  out->gyro_rads[1] = -sgy;
  out->gyro_rads[2] = -sgz;
  return 0;
}
```

## src/motion.c
```c
#include "motion.h"
#include "pid.h"
#include <errno.h>
#include <math.h>
#include <zephyr/drivers/gpio.h>
#include <zephyr/drivers/pwm.h>
#include <zephyr/kernel.h>

#define ZU DT_PATH(zephyr_user)

#define LOOP_PERIOD_MS 20     /* 50 Hz control loop */
#define CMD_TIMEOUT_MS 1000   /* stop if no new command for this long */
#define HEADING_STALE_MS 2000 /* heading older than this is ignored */
#define DUTY_MAX 0.95f        /* BTS7960 high-side bootstrap needs off time */
#define DUTY_DEADBAND 0.02f
#define MAX_STEP 0.05f /* max command change per loop (ramp) */

#define STACK_SIZE 2048
#define THREAD_PRIO 3

/* index 2*wheel = RPWM, 2*wheel+1 = LPWM, wheel order FL FR RL RR */
static const struct pwm_dt_spec pwm_ch[WHEEL_COUNT * 2] = {
    PWM_DT_SPEC_GET_BY_IDX(ZU, 0), PWM_DT_SPEC_GET_BY_IDX(ZU, 1),
    PWM_DT_SPEC_GET_BY_IDX(ZU, 2), PWM_DT_SPEC_GET_BY_IDX(ZU, 3),
    PWM_DT_SPEC_GET_BY_IDX(ZU, 4), PWM_DT_SPEC_GET_BY_IDX(ZU, 5),
    PWM_DT_SPEC_GET_BY_IDX(ZU, 6), PWM_DT_SPEC_GET_BY_IDX(ZU, 7),
};

static const struct gpio_dt_spec en_gpio = GPIO_DT_SPEC_GET(ZU, enable_gpios);

/* If a wheel spins the wrong way when driving forward, flip it here. */
static const bool invert[WHEEL_COUNT] = {false, false, false, false};

enum mode { MODE_STOP, MODE_DRIVE, MODE_HEADING };

static struct {
  enum mode mode;
  float speed;
  float turn;
  float heading_target;
  float heading_meas;
  int64_t heading_meas_ms;
  int64_t last_cmd_ms;
  bool enabled;
} st;

K_MUTEX_DEFINE(st_lock);

static pid_ctrl_t heading_pid;
static float prev_cmd[WHEEL_COUNT];
static float out_cmd[WHEEL_COUNT];

static K_THREAD_STACK_DEFINE(motion_stack, STACK_SIZE);
static struct k_thread motion_thread_data;

static float wrap180(float a) {
  while (a > 180.0f) {
    a -= 360.0f;
  }
  while (a <= -180.0f) {
    a += 360.0f;
  }
  return a;
}

static float clampf(float v, float lo, float hi) {
  return v < lo ? lo : (v > hi ? hi : v);
}

static void apply_wheel(int w, float cmd) {
  if (invert[w]) {
    cmd = -cmd;
  }

  float duty = fabsf(cmd);

  if (duty < DUTY_DEADBAND) {
    duty = 0.0f;
  }
  if (duty > DUTY_MAX) {
    duty = DUTY_MAX;
  }

  const struct pwm_dt_spec *r = &pwm_ch[2 * w];
  const struct pwm_dt_spec *l = &pwm_ch[2 * w + 1];
  uint32_t pulse = (uint32_t)(duty * (float)r->period);

  /* switch the side that goes off first, so both are never on together */
  if (cmd >= 0.0f) {
    pwm_set_dt(l, l->period, 0);
    pwm_set_dt(r, r->period, pulse);
  } else {
    pwm_set_dt(r, r->period, 0);
    pwm_set_dt(l, l->period, pulse);
  }
}

static void control_step(float dt) {
  static enum mode prev_mode = MODE_STOP;
  enum mode mode;
  float speed, turn_in, hdg_t, hdg_m;
  int64_t hdg_ms, cmd_ms;
  bool en;

  k_mutex_lock(&st_lock, K_FOREVER);
  mode = st.mode;
  speed = st.speed;
  turn_in = st.turn;
  hdg_t = st.heading_target;
  hdg_m = st.heading_meas;
  hdg_ms = st.heading_meas_ms;
  cmd_ms = st.last_cmd_ms;
  en = st.enabled;
  k_mutex_unlock(&st_lock);

  int64_t now = k_uptime_get();
  bool active = en && mode != MODE_STOP && (now - cmd_ms) < CMD_TIMEOUT_MS;

  if (!active) {
    pid_reset(&heading_pid);
    for (int w = 0; w < WHEEL_COUNT; w++) {
      prev_cmd[w] = 0.0f;
      out_cmd[w] = 0.0f;
      apply_wheel(w, 0.0f);
    }
    prev_mode = mode;
    return;
  }

  if (mode != prev_mode) {
    pid_reset(&heading_pid);
    prev_mode = mode;
  }

  float turn = 0.0f;

  if (mode == MODE_DRIVE) {
    turn = turn_in;
  } else {
    if ((now - hdg_ms) < HEADING_STALE_MS) {
      /* heading grows clockwise, a positive error means turn right,
       * and our turn value is positive for LEFT, so negate it */
      float err = wrap180(hdg_t - hdg_m);

      turn = -pid_update_error(&heading_pid, err, dt);
    } else {
      /* no heading yet (not GPS-aligned): go straight */
      pid_reset(&heading_pid);
      turn = 0.0f;
    }
  }
  turn = clampf(turn, -1.0f, 1.0f);

  /* skid-steer mix: turning left makes the left side slower */
  float left = speed - turn;
  float right = speed + turn;
  float m = fmaxf(fabsf(left), fabsf(right));

  if (m > 1.0f) {
    left /= m; /* keep the ratio, so the turn stays the same */
    right /= m;
  }

  float target[WHEEL_COUNT];

  target[WHEEL_FL] = left;
  target[WHEEL_RL] = left;
  target[WHEEL_FR] = right;
  target[WHEEL_RR] = right;

  for (int w = 0; w < WHEEL_COUNT; w++) {
    float cmd = clampf(target[w], -1.0f, 1.0f);

    /* acceleration limit */
    cmd = clampf(cmd, prev_cmd[w] - MAX_STEP, prev_cmd[w] + MAX_STEP);
    prev_cmd[w] = cmd;
    out_cmd[w] = cmd;

    apply_wheel(w, cmd);
  }
}

static void motion_thread(void *a, void *b, void *c) {
  int64_t ref = k_uptime_get();

  while (1) {
    k_sleep(K_MSEC(LOOP_PERIOD_MS));

    float dt = (float)k_uptime_delta(&ref) / 1000.0f;

    if (dt <= 0.0f || dt > 0.2f) {
      dt = LOOP_PERIOD_MS / 1000.0f;
    }
    control_step(dt);
  }
}

int motion_init(void) {
  for (int i = 0; i < WHEEL_COUNT * 2; i++) {
    if (!pwm_is_ready_dt(&pwm_ch[i])) {
      return -ENODEV;
    }
  }
  if (!gpio_is_ready_dt(&en_gpio)) {
    return -ENODEV;
  }
  gpio_pin_configure_dt(&en_gpio, GPIO_OUTPUT_INACTIVE);

  /* starting gains: placeholders, tune on the real rover */
  pid_init(&heading_pid, 0.015f, 0.0005f, 0.002f, -1.0f, 1.0f);
  for (int w = 0; w < WHEEL_COUNT; w++) {
    apply_wheel(w, 0.0f);
  }

  st.mode = MODE_STOP;
  st.heading_meas_ms = INT64_MIN / 2;

  k_thread_create(&motion_thread_data, motion_stack,
                  K_THREAD_STACK_SIZEOF(motion_stack), motion_thread, NULL,
                  NULL, NULL, THREAD_PRIO, 0, K_NO_WAIT);
  return 0;
}

void motion_enable(bool on) {
  k_mutex_lock(&st_lock, K_FOREVER);
  st.enabled = on;
  if (!on) {
    st.mode = MODE_STOP;
  }
  k_mutex_unlock(&st_lock);

  gpio_pin_set_dt(&en_gpio, on ? 1 : 0);
  if (!on) {
    for (int w = 0; w < WHEEL_COUNT; w++) {
      apply_wheel(w, 0.0f);
    }
  }
}

void motion_stop(void) {
  k_mutex_lock(&st_lock, K_FOREVER);
  st.mode = MODE_STOP;
  k_mutex_unlock(&st_lock);
}

void motion_set_drive(float speed, float turn) {
  k_mutex_lock(&st_lock, K_FOREVER);
  st.mode = MODE_DRIVE;
  st.speed = clampf(speed, -1.0f, 1.0f);
  st.turn = clampf(turn, -1.0f, 1.0f);
  st.last_cmd_ms = k_uptime_get();
  k_mutex_unlock(&st_lock);
}

void motion_set_heading(float speed, float heading_deg) {
  while (heading_deg < 0.0f) {
    heading_deg += 360.0f;
  }
  while (heading_deg >= 360.0f) {
    heading_deg -= 360.0f;
  }

  k_mutex_lock(&st_lock, K_FOREVER);
  st.mode = MODE_HEADING;
  st.speed = clampf(speed, -1.0f, 1.0f);
  st.heading_target = heading_deg;
  st.last_cmd_ms = k_uptime_get();
  k_mutex_unlock(&st_lock);
}

void motion_update_heading_measurement(float heading_deg) {
  k_mutex_lock(&st_lock, K_FOREVER);
  st.heading_meas = heading_deg;
  st.heading_meas_ms = k_uptime_get();
  k_mutex_unlock(&st_lock);
}

void motion_tune_heading(float kp, float ki, float kd) {
  k_mutex_lock(&st_lock, K_FOREVER);
  heading_pid.kp = kp;
  heading_pid.ki = ki;
  heading_pid.kd = kd;
  k_mutex_unlock(&st_lock);
}

void motion_get_wheel_cmd(float out[WHEEL_COUNT]) {
  for (int w = 0; w < WHEEL_COUNT; w++) {
    out[w] = out_cmd[w];
  }
}
```

## src/motion.h
```c
#pragma once
#include <stdbool.h>

enum wheel { WHEEL_FL, WHEEL_FR, WHEEL_RL, WHEEL_RR, WHEEL_COUNT };

int motion_init(void);       /* starts the 50 Hz control thread */
void motion_enable(bool on); /* BTS7960 enable pin */
void motion_stop(void);

/* speed: -1..1 (forward +). turn: -1..1 (+ = left, left side slower). */
void motion_set_drive(float speed, float turn);

/* Closed-loop heading. heading in degrees, 0 = north, clockwise. */
void motion_set_heading(float speed, float heading_deg);
void motion_update_heading_measurement(float heading_deg);

void motion_tune_heading(float kp, float ki, float kd);
void motion_get_wheel_cmd(float out[WHEEL_COUNT]);
```

## src/pid.c
```c
#include "pid.h"

void pid_init(pid_ctrl_t *p, float kp, float ki, float kd, float out_min,
              float out_max) {
  p->kp = kp;
  p->ki = ki;
  p->kd = kd;
  p->out_min = out_min;
  p->out_max = out_max;
  pid_reset(p);
}

void pid_reset(pid_ctrl_t *p) {
  p->integral = 0.0f;
  p->prev_error = 0.0f;
  p->first = true;
}

float pid_update_error(pid_ctrl_t *p, float error, float dt) {
  if (dt <= 0.0f) {
    return 0.0f;
  }

  float deriv = p->first ? 0.0f : (error - p->prev_error) / dt;

  p->first = false;
  p->prev_error = error;

  float integral = p->integral + error * dt;
  float out = p->kp * error + p->ki * integral + p->kd * deriv;

  /* anti-windup: only keep integrating if it helps leave saturation */
  if (out > p->out_max) {
    out = p->out_max;
    if (error < 0.0f) {
      p->integral = integral;
    }
  } else if (out < p->out_min) {
    out = p->out_min;
    if (error > 0.0f) {
      p->integral = integral;
    }
  } else {
    p->integral = integral;
  }
  return out;
}

float pid_update(pid_ctrl_t *p, float setpoint, float measurement, float dt) {
  return pid_update_error(p, setpoint - measurement, dt);
}
```

## src/pid.h
```c
#pragma once
#include <stdbool.h>

typedef struct {
  float kp, ki, kd;
  float out_min, out_max;
  float integral;
  float prev_error;
  bool first;
} pid_ctrl_t;

void pid_init(pid_ctrl_t *p, float kp, float ki, float kd, float out_min,
              float out_max);
void pid_reset(pid_ctrl_t *p);

/* error = setpoint - measurement */
float pid_update_error(pid_ctrl_t *p, float error, float dt);
float pid_update(pid_ctrl_t *p, float setpoint, float measurement, float dt);
```

## src/tof.c
```c
#include "tof.h"
#include <errno.h>
#include <zephyr/device.h>
#include <zephyr/devicetree.h>
#include <zephyr/drivers/sensor.h>

static const struct device *tof_dev = DEVICE_DT_GET(DT_NODELABEL(tof));

int tof_sensor_init(void) { return device_is_ready(tof_dev) ? 0 : -ENODEV; }

int tof_sensor_read(struct tof_data *d) {
  struct sensor_value v;
  int rc = sensor_sample_fetch(tof_dev);

  if (rc) {
    return rc;
  }
  rc = sensor_channel_get(tof_dev, SENSOR_CHAN_DISTANCE, &v);
  if (rc) {
    return rc;
  }
  d->dist_mm =
      (float)sensor_value_to_double(&v) * 1000.0f; /* driver gives meters */
  return 0;
}
```

## src/tof.h
```c
#ifndef TOF_H
#define TOF_H

struct tof_data {
  float dist_mm;
};

/* returns 0 on success, -ENODEV if the sensor isn't ready */
int tof_sensor_init(void);

/* blocks for up to one timing budget (about 30-50 ms) */
int tof_sensor_read(struct tof_data *d);

#endif
```
